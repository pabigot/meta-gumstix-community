## conf/machine/overo.conf
```bitbake
#@TYPE: Machine
#@NAME: overo machine
#@DESCRIPTION: Machine configuration for the Gumstix Overo

require conf/machine/include/omap3.inc

###############################################################################
# u-boot
EXTRA_IMAGEDEPENDS = "u-boot"
PREFERRED_PROVIDER_virtual/bootloader = "u-boot"
UBOOT_MACHINE = "omap3_overo_config"
PREFERRED_VERSION_u-boot = "2012.07"

###############################################################################
# kernel

require recipes-kernel/linux/linux-versions-overo.inc

PREFERRED_PROVIDER_virtual/kernel               = "${PREF_KERNEL_PROVIDER}"

# this should be PREFERRED_VERSION_virtual/kernel but this is not implemented
# choosing other kernels than linux-omap might cause warnings
PREFERRED_VERSION_linux-omap                    = "${PREF_KERNEL_PV}"

SERIAL_CONSOLE = "115200 ttyO2"

###############################################################################
# X
PREFERRED_PROVIDER_virtual/xserver = "xserver-xorg"
XSERVER = "xserver-xorg \
           xf86-input-evdev \
           xf86-input-mouse \
           xf86-video-omapfb \
           xf86-input-keyboard \
           xf86-input-tslib \
"

###############################################################################
# UBI
# do ubiattach /dev/ubi_ctrl -m 4
# From dmesg:
# UBI: smallest flash I/O unit:    2048
# UBI: logical eraseblock size:    129024 bytes
# from ubiattach stdout:
# UBI device number 0, total 1996 LEBs
MKUBIFS_ARGS = "-m 2048 -e 129024 -c 1996"

# do ubiattach /dev/ubi_ctrl -m 4
# from dmesg:
# UBI: smallest flash I/O unit:    2048
# UBI: physical eraseblock size:   131072 bytes (128 KiB)
# UBI: sub-page size:              512
UBINIZE_ARGS = "-m 2048 -p 128KiB -s 512"
UBI_VOLNAME = "rootfs"

###############################################################################
# misc
GUI_MACHINE_CLASS = "bigscreen"

IMAGE_FSTYPES += "tar.bz2"
# IMAGE_FSTYPES += "ubi tar.bz2"

MACHINE_EXTRA_RRECOMMENDS = "kernel-modules linux-firmware-sd8686 libgles-omap3 udev-udisks-rules-overo"
#task-ti-drivers

MACHINE_FEATURES = "kernel26 alsa apm ext2 screen usbgadget usbhost vfat"
# touchscreen
```
